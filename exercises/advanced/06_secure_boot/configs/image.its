## exercises/advanced/06_secure_boot/configs/image.its
```
/*
 * FIT Image Source for BeagleBone Black
 * 
 * Template for creating signed FIT images
 * 
 * Usage:
 *   1. Replace paths with actual kernel and DTB locations
 *   2. Generate keys with generate_keys.sh
 *   3. Build and sign: mkimage -f image.its -k ./keys -r image.fit
 *
 * Author: Embedded Linux Labs
 * License: MIT
 */

/dts-v1/;

/ {
    description = "Signed kernel image for BeagleBone Black";
    #address-cells = <1>;

    /*
     * Images Section
     * Contains all bootable components (kernel, DTB, ramdisk)
     */
    images {
        /*
         * Linux Kernel Image
         * - zImage compressed kernel
         * - Load and entry addresses for AM335x
         */
        kernel-1 {
            description = "Linux kernel for AM335x";
            data = /incbin/("zImage");
            type = "kernel";
            arch = "arm";
            os = "linux";
            compression = "none";
            load = <0x82000000>;
            entry = <0x82000000>;
            
            /*
             * Hash node - Integrity check
             * SHA-256 provides strong integrity verification
             */
            hash-1 {
                algo = "sha256";
            };
            
            /*
             * Signature node - Authentication
             * RSA-2048 + SHA-256 for cryptographic verification
             * key-name-hint must match key file name (without extension)
             */
            signature-1 {
                algo = "sha256,rsa2048";
                key-name-hint = "dev_key";
            };
        };

        /*
         * Device Tree Blob
         * - Platform-specific hardware description
         */
        fdt-1 {
            description = "BeagleBone Black Device Tree";
            data = /incbin/("am335x-boneblack.dtb");
            type = "flat_dt";
            arch = "arm";
            compression = "none";
            load = <0x88000000>;
            
            hash-1 {
                algo = "sha256";
            };
            
            signature-1 {
                algo = "sha256,rsa2048";
                key-name-hint = "dev_key";
            };
        };

        /*
         * Optional: Initial Ramdisk
         * Uncomment if using initramfs
         */
        /*
        ramdisk-1 {
            description = "Initial Ramdisk";
            data = /incbin/("initramfs.cpio.gz");
            type = "ramdisk";
            arch = "arm";
            os = "linux";
            compression = "gzip";
            
            hash-1 {
                algo = "sha256";
            };
            
            signature-1 {
                algo = "sha256,rsa2048";
                key-name-hint = "dev_key";
            };
        };
        */
    };

    /*
     * Configurations Section
     * Defines boot configurations combining images
     */
    configurations {
        default = "conf-1";

        /*
         * Standard Boot Configuration
         * Kernel + DTB, signed together
         */
        conf-1 {
            description = "BeagleBone Black - Standard Boot";
            kernel = "kernel-1";
            fdt = "fdt-1";
            /* ramdisk = "ramdisk-1"; */
            
            /*
             * Configuration Signature
             * Signs the entire configuration including all referenced images
             * This ensures all components are verified together
             */
            signature-1 {
                algo = "sha256,rsa2048";
                key-name-hint = "dev_key";
                sign-images = "kernel", "fdt";
                /* sign-images = "kernel", "fdt", "ramdisk"; */
            };
        };

        /*
         * Optional: Recovery Configuration
         * Different DTB for recovery mode
         */
        /*
        conf-recovery {
            description = "BeagleBone Black - Recovery Mode";
            kernel = "kernel-1";
            fdt = "fdt-recovery";
            
            signature-1 {
                algo = "sha256,rsa2048";
                key-name-hint = "dev_key";
                sign-images = "kernel", "fdt";
            };
        };
        */
    };
};
```

## exercises/advanced/06_secure_boot/configs/image_multi.its
```
/*
 * FIT Image with Multiple Configurations
 * 
 * Demonstrates multi-config FIT images for:
 * - Standard boot
 * - Recovery boot
 * - Debug boot
 *
 * Author: Embedded Linux Labs
 * License: MIT
 */

/dts-v1/;

/ {
    description = "Multi-configuration secure boot image";
    #address-cells = <1>;

    images {
        /* Production kernel - optimized */
        kernel-prod {
            description = "Production Linux kernel (optimized)";
            data = /incbin/("zImage");
            type = "kernel";
            arch = "arm";
            os = "linux";
            compression = "none";
            load = <0x82000000>;
            entry = <0x82000000>;
            
            hash-1 { algo = "sha256"; };
            signature-1 {
                algo = "sha256,rsa2048";
                key-name-hint = "prod_key";
            };
        };

        /* Debug kernel - with debug symbols */
        kernel-debug {
            description = "Debug Linux kernel";
            data = /incbin/("zImage-debug");
            type = "kernel";
            arch = "arm";
            os = "linux";
            compression = "none";
            load = <0x82000000>;
            entry = <0x82000000>;
            
            hash-1 { algo = "sha256"; };
            signature-1 {
                algo = "sha256,rsa2048";
                key-name-hint = "dev_key";
            };
        };

        /* Standard device tree */
        fdt-standard {
            description = "Standard Device Tree";
            data = /incbin/("am335x-boneblack.dtb");
            type = "flat_dt";
            arch = "arm";
            compression = "none";
            load = <0x88000000>;
            
            hash-1 { algo = "sha256"; };
            signature-1 {
                algo = "sha256,rsa2048";
                key-name-hint = "prod_key";
            };
        };

        /* Recovery device tree - minimal configuration */
        fdt-recovery {
            description = "Recovery Device Tree (minimal)";
            data = /incbin/("am335x-boneblack-recovery.dtb");
            type = "flat_dt";
            arch = "arm";
            compression = "none";
            load = <0x88000000>;
            
            hash-1 { algo = "sha256"; };
            signature-1 {
                algo = "sha256,rsa2048";
                key-name-hint = "prod_key";
            };
        };

        /* Minimal recovery ramdisk */
        ramdisk-recovery {
            description = "Recovery Ramdisk";
            data = /incbin/("recovery.cpio.gz");
            type = "ramdisk";
            arch = "arm";
            os = "linux";
            compression = "gzip";
            
            hash-1 { algo = "sha256"; };
            signature-1 {
                algo = "sha256,rsa2048";
                key-name-hint = "prod_key";
            };
        };
    };

    configurations {
        /* Default to production configuration */
        default = "production";

        /*
         * Production Configuration
         * - Optimized kernel
         * - Standard DTB
         * - No ramdisk (uses rootfs partition)
         */
        production {
            description = "Production Boot";
            kernel = "kernel-prod";
            fdt = "fdt-standard";
            
            signature-1 {
                algo = "sha256,rsa2048";
                key-name-hint = "prod_key";
                sign-images = "kernel", "fdt";
            };
        };

        /*
         * Recovery Configuration
         * - Same kernel, minimal DTB
         * - Includes recovery ramdisk
         * - Self-contained recovery environment
         */
        recovery {
            description = "Recovery Mode";
            kernel = "kernel-prod";
            fdt = "fdt-recovery";
            ramdisk = "ramdisk-recovery";
            
            signature-1 {
                algo = "sha256,rsa2048";
                key-name-hint = "prod_key";
                sign-images = "kernel", "fdt", "ramdisk";
            };
        };

        /*
         * Debug Configuration
         * - Debug kernel with symbols
         * - Standard DTB
         * - For development and debugging
         */
        debug {
            description = "Debug Mode";
            kernel = "kernel-debug";
            fdt = "fdt-standard";
            
            signature-1 {
                algo = "sha256,rsa2048";
                key-name-hint = "dev_key";
                sign-images = "kernel", "fdt";
            };
        };
    };
};

/*
 * U-Boot usage:
 * 
 * # Boot default (production):
 * bootm ${loadaddr}
 * 
 * # Boot specific configuration:
 * bootm ${loadaddr}#recovery
 * bootm ${loadaddr}#debug
 * 
 * # List configurations:
 * iminfo ${loadaddr}
 */
```

## exercises/advanced/06_secure_boot/configs/image_with_ramdisk.its
```
/*
 * FIT Image Source with Initramfs
 * 
 * Complete FIT image including kernel, DTB, and ramdisk
 * For use with initramfs-based systems
 *
 * Author: Embedded Linux Labs
 * License: MIT
 */

/dts-v1/;

/ {
    description = "Signed boot image with initramfs";
    #address-cells = <1>;

    images {
        kernel-1 {
            description = "Linux kernel for AM335x";
            data = /incbin/("zImage");
            type = "kernel";
            arch = "arm";
            os = "linux";
            compression = "none";
            load = <0x82000000>;
            entry = <0x82000000>;
            
            hash-1 {
                algo = "sha256";
            };
            
            signature-1 {
                algo = "sha256,rsa2048";
                key-name-hint = "dev_key";
            };
        };

        fdt-1 {
            description = "BeagleBone Black Device Tree";
            data = /incbin/("am335x-boneblack.dtb");
            type = "flat_dt";
            arch = "arm";
            compression = "none";
            load = <0x88000000>;
            
            hash-1 {
                algo = "sha256";
            };
            
            signature-1 {
                algo = "sha256,rsa2048";
                key-name-hint = "dev_key";
            };
        };

        ramdisk-1 {
            description = "Initial Ramdisk (GZIP compressed CPIO)";
            data = /incbin/("initramfs.cpio.gz");
            type = "ramdisk";
            arch = "arm";
            os = "linux";
            compression = "gzip";
            
            hash-1 {
                algo = "sha256";
            };
            
            signature-1 {
                algo = "sha256,rsa2048";
                key-name-hint = "dev_key";
            };
        };
    };

    configurations {
        default = "conf-1";

        conf-1 {
            description = "Boot with initramfs";
            kernel = "kernel-1";
            fdt = "fdt-1";
            ramdisk = "ramdisk-1";
            
            signature-1 {
                algo = "sha256,rsa2048";
                key-name-hint = "dev_key";
                sign-images = "kernel", "fdt", "ramdisk";
            };
        };
    };
};
```

## exercises/advanced/07_buildroot/configs/bbb_custom_defconfig
```kconfig
# BeagleBone Black Custom Configuration for Buildroot
# 
# Apply with:
#   cd ~/bbb-buildroot/buildroot-2024.02
#   make BR2_EXTERNAL=~/bbb-buildroot/bbb-external bbb_custom_defconfig
#
# Author: Embedded Linux Labs
# License: MIT

#
# Target Architecture
#
BR2_arm=y
BR2_cortex_a8=y
BR2_ARM_EABIHF=y
BR2_ARM_FPU_VFPV3=y

#
# Build Options
#
BR2_CCACHE=y
BR2_CCACHE_DIR="/tmp/buildroot-ccache"
BR2_ENABLE_DEBUG=y

#
# Toolchain
#
BR2_TOOLCHAIN_BUILDROOT_GLIBC=y
BR2_TOOLCHAIN_BUILDROOT_CXX=y

#
# System Configuration
#
BR2_TARGET_GENERIC_HOSTNAME="bbb"
BR2_TARGET_GENERIC_ISSUE="Welcome to BeagleBone Black Custom Build"
BR2_SYSTEM_BIN_SH_BASH=y
BR2_ENABLE_LOCALE_PURGE=y
BR2_TARGET_GENERIC_ROOT_PASSWD="root"
BR2_SYSTEM_DHCP="eth0"
BR2_TARGET_TZ_INFO=y
BR2_TARGET_LOCALTIME="America/New_York"

#
# Kernel
#
BR2_LINUX_KERNEL=y
BR2_LINUX_KERNEL_CUSTOM_VERSION=y
BR2_LINUX_KERNEL_CUSTOM_VERSION_VALUE="6.6.28"
BR2_LINUX_KERNEL_USE_DEFCONFIG=y
BR2_LINUX_KERNEL_DEFCONFIG="omap2plus"
BR2_LINUX_KERNEL_ZIMAGE=y
BR2_LINUX_KERNEL_DTS_SUPPORT=y
BR2_LINUX_KERNEL_INTREE_DTS_NAME="am335x-boneblack"
BR2_LINUX_KERNEL_INSTALL_TARGET=y

#
# Bootloader
#
BR2_TARGET_UBOOT=y
BR2_TARGET_UBOOT_BUILD_SYSTEM_KCONFIG=y
BR2_TARGET_UBOOT_CUSTOM_VERSION=y
BR2_TARGET_UBOOT_CUSTOM_VERSION_VALUE="2024.01"
BR2_TARGET_UBOOT_BOARD_DEFCONFIG="am335x_evm"
BR2_TARGET_UBOOT_FORMAT_IMG=y
BR2_TARGET_UBOOT_SPL=y
BR2_TARGET_UBOOT_SPL_NAME="MLO"

#
# Filesystem
#
BR2_TARGET_ROOTFS_EXT2=y
BR2_TARGET_ROOTFS_EXT2_4=y
BR2_TARGET_ROOTFS_EXT2_SIZE="256M"
BR2_TARGET_ROOTFS_TAR=y

#
# BusyBox
#
BR2_PACKAGE_BUSYBOX_SHOW_OTHERS=y

#
# Core Utilities
#
BR2_PACKAGE_BASH=y
BR2_PACKAGE_COREUTILS=y
BR2_PACKAGE_FILE=y
BR2_PACKAGE_FINDUTILS=y
BR2_PACKAGE_GAWK=y
BR2_PACKAGE_GREP=y
BR2_PACKAGE_LESS=y
BR2_PACKAGE_SED=y
BR2_PACKAGE_SUDO=y
BR2_PACKAGE_TAR=y
BR2_PACKAGE_UTIL_LINUX=y

#
# Development Tools
#
BR2_PACKAGE_GIT=y
BR2_PACKAGE_MAKE=y
BR2_PACKAGE_PATCH=y

#
# Debugging/Profiling
#
BR2_PACKAGE_GDB=y
BR2_PACKAGE_STRACE=y
BR2_PACKAGE_LTRACE=y
BR2_PACKAGE_HTOP=y
BR2_PACKAGE_LSOF=y

#
# Hardware Tools
#
BR2_PACKAGE_I2C_TOOLS=y
BR2_PACKAGE_SPI_TOOLS=y
BR2_PACKAGE_CAN_UTILS=y
BR2_PACKAGE_DEVMEM2=y
BR2_PACKAGE_MEMTESTER=y
BR2_PACKAGE_EVTEST=y
BR2_PACKAGE_USBUTILS=y

#
# GPIO/PWM
#
BR2_PACKAGE_LIBGPIOD=y
BR2_PACKAGE_LIBGPIOD_TOOLS=y

#
# Networking
#
BR2_PACKAGE_DROPBEAR=y
# BR2_PACKAGE_OPENSSH=y
BR2_PACKAGE_IPERF3=y
BR2_PACKAGE_IPROUTE2=y
BR2_PACKAGE_IPUTILS=y
BR2_PACKAGE_ETHTOOL=y
BR2_PACKAGE_TCPDUMP=y
BR2_PACKAGE_WGET=y
BR2_PACKAGE_CURL=y
BR2_PACKAGE_NTP=y

#
# Scripting Languages
#
# BR2_PACKAGE_PYTHON3=y
# BR2_PACKAGE_PYTHON_PIP=y

#
# Libraries
#
BR2_PACKAGE_OPENSSL=y
BR2_PACKAGE_ZLIB=y
BR2_PACKAGE_NCURSES=y

#
# Init System (choose one)
#
# BusyBox init (minimal)
BR2_INIT_BUSYBOX=y

# SystemD (full-featured, larger)
# BR2_INIT_SYSTEMD=y

#
# /dev management
#
BR2_ROOTFS_DEVICE_CREATION_DYNAMIC_DEVTMPFS=y

#
# External tree (uncomment when using)
#
# BR2_ROOTFS_OVERLAY="$(BR2_EXTERNAL_BBB_EXTERNAL_PATH)/board/bbb/rootfs_overlay"
# BR2_ROOTFS_POST_BUILD_SCRIPT="$(BR2_EXTERNAL_BBB_EXTERNAL_PATH)/board/bbb/post_build.sh"
# BR2_ROOTFS_POST_IMAGE_SCRIPT="$(BR2_EXTERNAL_BBB_EXTERNAL_PATH)/board/bbb/post_image.sh"
```

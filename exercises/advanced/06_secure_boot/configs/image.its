## exercises/advanced/07_buildroot/configs/bbb_minimal_defconfig
```kconfig
# BeagleBone Black Minimal Configuration
#
# Ultra-minimal system for fast boot and small footprint
#
# Author: Embedded Linux Labs
# License: MIT

#
# Target Architecture
#
BR2_arm=y
BR2_cortex_a8=y
BR2_ARM_EABIHF=y
BR2_ARM_FPU_VFPV3=y

#
# Toolchain - Use musl for smaller size
#
BR2_TOOLCHAIN_BUILDROOT_MUSL=y
# BR2_TOOLCHAIN_BUILDROOT_CXX is not set

#
# System Configuration
#
BR2_TARGET_GENERIC_HOSTNAME="bbb"
BR2_TARGET_GENERIC_ISSUE="BBB Minimal"
BR2_SYSTEM_BIN_SH_BUSYBOX_ASH=y
BR2_TARGET_GENERIC_ROOT_PASSWD=""
BR2_TARGET_GENERIC_REMOUNT_ROOTFS_RW=y

#
# Kernel - Minimal configuration
#
BR2_LINUX_KERNEL=y
BR2_LINUX_KERNEL_CUSTOM_VERSION=y
BR2_LINUX_KERNEL_CUSTOM_VERSION_VALUE="6.6.28"
BR2_LINUX_KERNEL_USE_DEFCONFIG=y
BR2_LINUX_KERNEL_DEFCONFIG="omap2plus"
BR2_LINUX_KERNEL_ZIMAGE=y
BR2_LINUX_KERNEL_DTS_SUPPORT=y
BR2_LINUX_KERNEL_INTREE_DTS_NAME="am335x-boneblack"
# Use LZO for faster decompression
BR2_LINUX_KERNEL_LZO=y

#
# Bootloader
#
BR2_TARGET_UBOOT=y
BR2_TARGET_UBOOT_BUILD_SYSTEM_KCONFIG=y
BR2_TARGET_UBOOT_CUSTOM_VERSION=y
BR2_TARGET_UBOOT_CUSTOM_VERSION_VALUE="2024.01"
BR2_TARGET_UBOOT_BOARD_DEFCONFIG="am335x_evm"
BR2_TARGET_UBOOT_FORMAT_IMG=y
BR2_TARGET_UBOOT_SPL=y
BR2_TARGET_UBOOT_SPL_NAME="MLO"

#
# Filesystem - Small ext4
#
BR2_TARGET_ROOTFS_EXT2=y
BR2_TARGET_ROOTFS_EXT2_4=y
BR2_TARGET_ROOTFS_EXT2_SIZE="64M"

#
# Init - Simple
#
BR2_INIT_BUSYBOX=y
BR2_ROOTFS_DEVICE_CREATION_DYNAMIC_DEVTMPFS=y

#
# Minimal packages
#
# BR2_PACKAGE_BUSYBOX_SHOW_OTHERS is not set

# Only dropbear for SSH
BR2_PACKAGE_DROPBEAR=y

# Basic hardware tools
BR2_PACKAGE_I2C_TOOLS=y
BR2_PACKAGE_DEVMEM2=y

#
# Compression
#
BR2_TARGET_ROOTFS_SQUASHFS=y
BR2_TARGET_ROOTFS_SQUASHFS_4_0=y
BR2_TARGET_ROOTFS_SQUASHFS_XZ=y
```

## exercises/advanced/07_buildroot/package/myapp/Config.in
```kconfig
config BR2_PACKAGE_MYAPP
    bool "myapp"
    depends on BR2_USE_WCHAR
    help
      My custom application for BeagleBone Black.
      
      This is an example package demonstrating how to add
      custom applications to Buildroot. It includes:
      
      - System information display
      - GPIO access examples
      - I2C communication
      
      Usage: myapp [-i] [-g] [-h]
      
      https://github.com/example/myapp

comment "myapp needs a toolchain w/ wchar"
    depends on !BR2_USE_WCHAR
```

## exercises/advanced/08_yocto/layer/conf/layer.conf
```bitbake
# Custom BeagleBone Black Layer
# Layer created by Embedded Linux Labs
#
# This is the layer configuration file for meta-bbb-custom

BBPATH .= ":${LAYERDIR}"

BBFILES += "${LAYERDIR}/recipes-*/*/*.bb \
            ${LAYERDIR}/recipes-*/*/*.bbappend"

BBFILE_COLLECTIONS += "meta-bbb-custom"
BBFILE_PATTERN_meta-bbb-custom = "^${LAYERDIR}/"
BBFILE_PRIORITY_meta-bbb-custom = "10"

LAYERDEPENDS_meta-bbb-custom = "core"
LAYERSERIES_COMPAT_meta-bbb-custom = "scarthgap nanbield kirkstone"
```
